/*
 * Copyright (c) 2020 The ZMK Contributors
 *
 * SPDX-License-Identifier: MIT
 */

 /*
 references:
	https://github.com/minusfive/zmk-config/blob/main/knucklehead/combos.dtsi
	https://github.com/filterpaper/zmk-config/blob/main/config/cradio.keymap
	https://github.com/caksoylar/zmk-config/blob/main/config/combos.dtsi
 */

#include "../sweep/sweep.keymap"
