## config/boards/shields/cradio/Kconfig.defconfig
```kconfig
# Copyright (c) 2020 The ZMK Contributors
# SPDX-License-Identifier: MIT

if SHIELD_CRADIO_DONGLE

config ZMK_KEYBOARD_NAME
	default "Sweep Dongle mod"

config ZMK_SPLIT_ROLE_CENTRAL
	default y

config ZMK_USB
	default y

endif

if SHIELD_CRADIO_CENTRAL_LEFT

config ZMK_KEYBOARD_NAME
	default "Sweep by Yoma"

config ZMK_SPLIT_ROLE_CENTRAL
	default y

endif

if ZMK_DISPLAY

config I2C
    default y

config SSD1306
    default y

choice ZMK_DISPLAY_WORK_QUEUE
    default ZMK_DISPLAY_WORK_QUEUE_DEDICATED
endchoice

endif

if LVGL

config LV_Z_VDB_SIZE
    default 64

config LV_DPI_DEF
    default 148

config LV_Z_DPI

default 148

config LV_Z_BITS_PER_PIXEL
    default 1

choice LV_COLOR_DEPTH
    default LV_COLOR_DEPTH_1
endchoice

endif


if SHIELD_CRADIO_LEFT || SHIELD_CRADIO_RIGHT || SHIELD_CRADIO_DONGLE || SHIELD_CRADIO_CENTRAL_LEFT

config ZMK_SPLIT
	default y

config ZMK_BLE
	default y

endif
```
