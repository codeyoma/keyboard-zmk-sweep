/**
 *	https://zmk.dev/docs/behaviors/macros
 */

/*
 #define MACRO_(NAME, TAP, WAIT, ...)					\
	/omit-if-no-ref/ NAME: macro_##NAME {				\
    label          = #NAME;								\
    compatible     = "zmk,behavior-macro";				\
    tap-ms         = <TAP>;								\
    wait-ms        = <WAIT>;							\
    #binding-cells = <0>;							   	\
	bindings       = __VA_ARGS__; 						\
};
*/

#define MACRO_(NAME, TAP, WAIT, BINDING)				\
	/omit-if-no-ref/ NAME: macro_##NAME {				\
    label          = #NAME;								\
    compatible     = "zmk,behavior-macro";				\
    tap-ms         = <TAP>;								\
    wait-ms        = <WAIT>;							\
    #binding-cells = <0>;							   	\
	bindings       = <BINDING>; 						\
};


/ {
    macros {

		/*
		/omit-if-no-ref/ nerd_w_move: nerd_w_macro {
			label			= "nerd_w_move";
			compatible		= "zmk,behavior-macro-one-param";
			tap-ms			= <0>;
			wait-ms			= <0>;
			#binding-cells	= <0>;
			bindings		=
				<&macro_press &kp LCTRL &kp W>,
				<&macro_param_1to1>,
				<&macro_tap &kp MACRO_PLACEHOLDER>,
				<&macro_pause_for_release>,
				<&macro_release &kp LCTRL &kp W>;
		};
		*/

		/omit-if-no-ref/ lang_ex: lang_change {
            compatible 		= "zmk,behavior-macro";
			tap-ms			= <0>;
			wait-ms			= <0>;
            #binding-cells	= <0>;
            bindings		=
				<&macro_tap &kp RALT>,
				<&macro_tap &tog COLEMAK>;
        };

        MACRO_(nerd_l, 1, 1, &kp LC(W) &kp H)
        MACRO_(nerd_r, 1, 1, &kp LC(W) &kp U)

    };
};
