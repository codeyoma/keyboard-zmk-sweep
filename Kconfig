## Kconfig
```kconfig
# Options for the code in this repository (see zephyr/module.yml).

config ZMK_MOUSE_SPEED
    bool "Mouse key speed levels (&mouse_speed)"
    default y
    depends on DT_HAS_ZMK_BEHAVIOR_MOUSE_SPEED_ENABLED
    depends on ZMK_POINTING
    depends on !ZMK_SPLIT || ZMK_SPLIT_ROLE_CENTRAL

if ZMK_MOUSE_SPEED

config ZMK_MOUSE_SPEED_LEVELS
    int "Number of mouse key speed levels"
    default 4
    help
      Level N moves at N / ZMK_MOUSE_SPEED_LEVELS of the full mouse key speed.

config ZMK_MOUSE_SPEED_DEFAULT_LEVEL
    int "Mouse key speed level before any level has been saved"
    default 2

endif
```

## dts/bindings/behaviors/zmk,behavior-keylay.yaml
```yaml
description: The KeyLay key, opens or closes the KeyLay cheat sheet on the computer (src/keylay.c)

compatible: "zmk,behavior-keylay"

include: zero_param.yaml
```

## dts/bindings/behaviors/zmk,behavior-mouse-speed.yaml
```yaml
description: Steps the mouse key speed level (src/mouse_speed.c), wrapping back to the first level

compatible: "zmk,behavior-mouse-speed"

include: zero_param.yaml
```

## dts/bindings/input_processors/zmk,input-processor-mouse-speed.yaml
```yaml
description: |
  Scales input values by a mouse key speed level (src/mouse_speed.c). The parameter is the
  level to use: 0 for the current level, or a fixed level such as 1 for sniping.

compatible: "zmk,input-processor-mouse-speed"

include: ip_one_param.yaml

properties:
  type:
    type: int
    required: true
  codes:
    type: array
    required: true
```
